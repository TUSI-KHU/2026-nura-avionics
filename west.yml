## west.yml
```yaml
manifest:
  version: "1.0"
  remotes:
    - name: zephyrproject-rtos
      url-base: https://github.com/zephyrproject-rtos
  projects:
    - name: zephyr
      remote: zephyrproject-rtos
      revision: v3.7.2
      import: true
  self:
    path: nura-avionics
```
